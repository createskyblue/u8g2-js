/* Cross-validation harness: render with the REAL u8g2 C library and dump
   the buffer bytes to stdout, so the JS port can be compared byte-for-byte. */
#include <stdio.h>
#include <stdlib.h>
#include "u8g2.h"
#ifdef _WIN32
#include <fcntl.h>
#include <io.h>
#endif

/* full CJK font generated by the patched bdfconv (tools/fontgen) */
extern const uint8_t chinese_full_12[] U8G2_FONT_SECTION("chinese_full_12");

static uint8_t gpio_cb(U8X8_UNUSED u8x8_t *u8x8, uint8_t msg, U8X8_UNUSED uint8_t arg_int, U8X8_UNUSED void *arg_ptr) {
  return 1;
}

static void scenario(u8g2_t *u8g2, int s) {
  switch (s) {
    case 1: /* text + boxes + lines */
      u8g2_SetFont(u8g2, u8g2_font_5x7_tf);
      u8g2_DrawStr(u8g2, 0, 10, "Hello");
      u8g2_DrawBox(u8g2, 0, 20, 10, 5);
      u8g2_DrawFrame(u8g2, 20, 20, 10, 5);
      u8g2_DrawRBox(u8g2, 40, 20, 12, 8, 3);
      u8g2_DrawRFrame(u8g2, 60, 20, 12, 8, 3);
      u8g2_DrawLine(u8g2, 0, 40, 30, 55);
      u8g2_DrawLine(u8g2, 0, 55, 30, 40);
      break;
    case 2: /* circles + ellipses + arc */
      u8g2_DrawCircle(u8g2, 20, 20, 8, U8G2_DRAW_ALL);
      u8g2_DrawDisc(u8g2, 50, 20, 8, U8G2_DRAW_ALL);
      u8g2_DrawEllipse(u8g2, 80, 20, 12, 6, U8G2_DRAW_ALL);
      u8g2_DrawFilledEllipse(u8g2, 110, 20, 10, 8, U8G2_DRAW_ALL);
      u8g2_DrawArc(u8g2, 20, 50, 8, 64, 128);
      break;
    case 3: /* triangle */
      u8g2_DrawTriangle(u8g2, 10, 40, 30, 10, 50, 40);
      break;
    case 4: /* xor + font modes */
      u8g2_SetFont(u8g2, u8g2_font_5x7_tf);
      u8g2_SetDrawColor(u8g2, 2);
      u8g2_DrawBox(u8g2, 0, 0, 32, 16);
      u8g2_DrawBox(u8g2, 0, 0, 32, 16);
      u8g2_SetDrawColor(u8g2, 1);
      u8g2_SetFontMode(u8g2, 1);
      u8g2_DrawStr(u8g2, 0, 10, "ABC");
      u8g2_SetFontMode(u8g2, 0);
      u8g2_DrawStr(u8g2, 0, 20, "XYZ");
      break;
    case 5: /* clip window */
      u8g2_SetFont(u8g2, u8g2_font_5x7_tf);
      u8g2_SetClipWindow(u8g2, 10, 10, 40, 30);
      u8g2_DrawBox(u8g2, 0, 0, 64, 40);
      u8g2_SetMaxClipWindow(u8g2);
      u8g2_DrawFrame(u8g2, 20, 20, 10, 5);
      break;
    case 6: /* font direction + 2x */
      u8g2_SetFont(u8g2, u8g2_font_5x7_tf);
      u8g2_SetFontDirection(u8g2, 1);
      u8g2_DrawStr(u8g2, 20, 20, "ABC");
      u8g2_SetFontDirection(u8g2, 0);
      u8g2_DrawGlyphX2(u8g2, 40, 20, 'A');
      u8g2_DrawStrX2(u8g2, 60, 20, "Hi");
      break;
    case 7: /* xbm + bitmap */
      {
        static const uint8_t xbm[] = { 0x81, 0x42, 0x24, 0x18, 0x24, 0x42, 0x81, 0x00, 0x18 };
        u8g2_DrawXBM(u8g2, 10, 10, 8, 9, xbm);
        u8g2_SetBitmapMode(u8g2, 1);
        u8g2_DrawXBM(u8g2, 20, 10, 8, 9, xbm);
      }
      break;
    case 8: /* button + utf8 widths */
      u8g2_SetFont(u8g2, u8g2_font_5x7_tf);
      u8g2_DrawButtonUTF8(u8g2, 30, 20, U8G2_BTN_BW2|U8G2_BTN_HCENTER, 0, 3, 1, "OK");
      break;
    case 9: /* single Z solid */
      u8g2_SetFont(u8g2, u8g2_font_5x7_tf);
      u8g2_DrawGlyph(u8g2, 0, 20, 'Z');
      break;
    case 10: /* single Z transparent */
      u8g2_SetFont(u8g2, u8g2_font_5x7_tf);
      u8g2_SetFontMode(u8g2, 1);
      u8g2_DrawGlyph(u8g2, 0, 20, 'Z');
      break;
    case 11: /* XYZ solid */
      u8g2_SetFont(u8g2, u8g2_font_5x7_tf);
      u8g2_DrawStr(u8g2, 0, 20, "XYZ");
      break;
    case 12: /* drawStr Z + Y separately to inspect */
      u8g2_SetFont(u8g2, u8g2_font_5x7_tf);
      u8g2_DrawGlyph(u8g2, 0, 20, 'X');
      u8g2_DrawGlyph(u8g2, 5, 20, 'Y');
      u8g2_DrawGlyph(u8g2, 10, 20, 'Z');
      break;
    case 13: /* dump the font bytes */
      fwrite(u8g2_font_5x7_tf, 1, 1612, stdout);
      break;
    case 14: /* unicode glyphs (unifont symbols) */
      u8g2_SetFont(u8g2, u8g2_font_unifont_t_symbols);
      u8g2_DrawGlyph(u8g2, 0, 16, 0x2605);   /* black star */
      u8g2_DrawGlyph(u8g2, 20, 16, 0x2192);  /* right arrow */
      u8g2_DrawGlyph(u8g2, 40, 16, 0x2660);  /* spade */
      u8g2_DrawGlyph(u8g2, 60, 16, 0x20ac);  /* euro */
      break;
    case 15: /* full CJK font (patched bdfconv validation) */
      u8g2_SetFont(u8g2, chinese_full_12);
      u8g2_DrawUTF8(u8g2, 0, 16, "你好世界，温度传感器 U8G2 测试！");
      u8g2_DrawUTF8(u8g2, 0, 40, "龘靐齉爩 天气晴朗 123ABC");
      u8g2_DrawUTF8(u8g2, 0, 60, "长命百岁万事如意");
      break;
    default:
      break;
  }
}

int main(int argc, char **argv) {
#ifdef _WIN32
  _setmode(_fileno(stdout), _O_BINARY); /* do not translate LF to CRLF */
#endif
  int s = 1, rot = 0;
  if (argc > 1) s = atoi(argv[1]);
  if (argc > 2) rot = atoi(argv[2]);
  const u8g2_cb_t *rcb = U8G2_R0;
  if (rot == 1) rcb = U8G2_R1;
  if (rot == 2) rcb = U8G2_R2;
  if (rot == 3) rcb = U8G2_R3;

  u8g2_t u8g2;
  u8g2_Setup_ssd1306_128x64_noname_f(&u8g2, rcb, u8x8_byte_empty, gpio_cb);
  u8g2_ClearBuffer(&u8g2);
  scenario(&u8g2, s);
  u8g2_SendBuffer(&u8g2);
  fwrite(u8g2_GetBufferPtr(&u8g2), 1, u8g2_GetBufferSize(&u8g2), stdout);
  return 0;
}
